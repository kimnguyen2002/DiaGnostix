// risk_model.h - the three generated risk models behind one interface.
//
// dgx_models.h (generated by the notebook, Section 15) holds three dependency-free C models:
//   DGX_PRI  primary   : the selected input set; needs a calibrated AD8232 gain
//   DGX_FB   fallback  : the same inputs without ECG amplitudes; used while the gain is not calibrated
//   DGX_ECG  ECG-only  : 32 ECG features; used when no profile is entered (privacy mode)
// Each header lists its input names. Inputs are looked up by name, so the firmware follows
// whatever input set the notebook selected without code changes. No Arduino dependency.
#pragma once

#include <math.h>
#include <stdint.h>
#include <string.h>

#include "dgx_models.h"
#include "ecg_features.h"

namespace dgx {

enum class ModelRole : uint8_t { kPrimary, kFallback, kEcgOnly, kNone };
enum class RiskTier : uint8_t { kLow, kElevated, kHigh, kNoResult };

constexpr int kMaxModelInputs = 48;
static_assert(DGX_PRI_N_FEATURES <= kMaxModelInputs && DGX_FB_N_FEATURES <= kMaxModelInputs &&
                  DGX_ECG_N_FEATURES <= kMaxModelInputs, "raise kMaxModelInputs");

// Inputs that do not come from the ECG. NAN = not available.
struct NonEcgInputs {
  float age = NAN;       // years
  float male_sex = NAN;  // 1 = male, 0 = female
  float bmi = NAN;       // kg/m2
  float sbp = NAN;       // mmHg (cuffless estimate or home cuff)
  float dbp = NAN;
  float smoking = NAN;   // 1 = smoker, 0 = non-smoker
  float drinking = NAN;  // 1 rarely, 2 occasionally, 3 regularly
};

struct ModelSpec {
  ModelRole role;
  const char* name;
  int n_inputs;
  const char* const* input_names;
  double (*score)(const float*);  // uncalibrated model probability
  double (*calibrate)(double);    // Platt-recalibrated probability
  double thr_youden;              // high tier: score >= thr_youden
  double thr_sens90;              // elevated tier: score >= min(thr_sens90, thr_youden)

  double highThreshold() const { return thr_youden; }
  double elevatedThreshold() const { return thr_sens90 < thr_youden ? thr_sens90 : thr_youden; }
  RiskTier tier(double s) const {
    if (!(s == s)) return RiskTier::kNoResult;
    if (s >= highThreshold()) return RiskTier::kHigh;
    if (s >= elevatedThreshold()) return RiskTier::kElevated;
    return RiskTier::kLow;
  }
};

inline const ModelSpec& modelSpec(ModelRole role) {
  static const ModelSpec kSpecs[3] = {
      {ModelRole::kPrimary, "primary", DGX_PRI_N_FEATURES, DGX_PRI_FEATURE_NAMES, dgx_pri_score, dgx_pri_calibrate,
       DGX_PRI_THRESHOLD_YOUDEN, DGX_PRI_THRESHOLD_SENS90},
      {ModelRole::kFallback, "fallback", DGX_FB_N_FEATURES, DGX_FB_FEATURE_NAMES, dgx_fb_score, dgx_fb_calibrate,
       DGX_FB_THRESHOLD_YOUDEN, DGX_FB_THRESHOLD_SENS90},
      {ModelRole::kEcgOnly, "ecg_only", DGX_ECG_N_FEATURES, DGX_ECG_FEATURE_NAMES, dgx_ecg_score, dgx_ecg_calibrate,
       DGX_ECG_THRESHOLD_YOUDEN, DGX_ECG_THRESHOLD_SENS90},
  };
  return kSpecs[role == ModelRole::kFallback ? 1 : (role == ModelRole::kEcgOnly ? 2 : 0)];
}

inline const char* roleName(ModelRole r) {
  switch (r) {
    case ModelRole::kPrimary: return "primary";
    case ModelRole::kFallback: return "fallback";
    case ModelRole::kEcgOnly: return "ecg_only";
    default: return "none";
  }
}

inline const char* tierName(RiskTier t) {
  switch (t) {
    case RiskTier::kLow: return "low";
    case RiskTier::kElevated: return "elevated";
    case RiskTier::kHigh: return "high";
    default: return "no_result";
  }
}

// Advice shown with each tier (same text as feature_spec.json for the app).
inline const char* tierAdvice(RiskTier t) {
  switch (t) {
    case RiskTier::kHigh:
      return "Raised risk of prediabetes or diabetes. Please visit a clinic or hospital for a fasting plasma "
             "glucose or HbA1c blood test.";
    case RiskTier::kElevated:
      return "Moderately raised risk. Ask for a fasting glucose or HbA1c test at your next check-up, or within "
             "the next few months.";
    case RiskTier::kLow:
      return "Low risk on this screen. It does not rule out diabetes; keep your regular health check-ups.";
    default:
      return "The ECG signal quality was too low for a result. Sit still, check the electrodes and measure again.";
  }
}

// Value of a named model input; false if the name is unknown to the firmware.
inline bool inputValue(const char* name, const EcgFeatures& f, const NonEcgInputs& p, float* out) {
  for (int i = 0; i < kNumFeatures; ++i) {
    if (!strcmp(name, kFeatureNames[i])) {
      *out = (float)f.value[i];  // the device feeds float32, as in the parity tests
      return true;
    }
  }
  struct Named { const char* name; float value; };
  const Named other[] = {{"age", p.age}, {"male_sex", p.male_sex}, {"BMI", p.bmi}, {"sBP", p.sbp},
                         {"dBP", p.dbp}, {"smoking", p.smoking}, {"drinking", p.drinking}};
  for (const Named& o : other) {
    if (!strcmp(name, o.name)) {
      *out = o.value;
      return true;
    }
  }
  return false;
}

inline bool isEcgInput(const char* name) {
  for (int i = 0; i < kNumFeatures; ++i)
    if (!strcmp(name, kFeatureNames[i])) return true;
  return false;
}

inline bool modelUses(const ModelSpec& m, const char* name) {
  for (int i = 0; i < m.n_inputs; ++i)
    if (!strcmp(m.input_names[i], name)) return true;
  return false;
}

// Boot self-test: every input of every model must be known to the firmware.
inline bool modelInputsKnown(const char** unknown = nullptr) {
  EcgFeatures f;
  NonEcgInputs p;
  float v;
  for (ModelRole r : {ModelRole::kPrimary, ModelRole::kFallback, ModelRole::kEcgOnly}) {
    const ModelSpec& m = modelSpec(r);
    for (int i = 0; i < m.n_inputs; ++i) {
      if (!inputValue(m.input_names[i], f, p, &v)) {
        if (unknown) *unknown = m.input_names[i];
        return false;
      }
    }
  }
  return true;
}

// True if every non-ECG input of the model is available (ECG inputs come from the recording).
inline bool nonEcgInputsAvailable(const ModelSpec& m, const NonEcgInputs& p, const char** missing = nullptr) {
  EcgFeatures f;
  float v;
  for (int i = 0; i < m.n_inputs; ++i) {
    const char* name = m.input_names[i];
    if (isEcgInput(name)) continue;
    if (!inputValue(name, f, p, &v) || !(v == v)) {
      if (missing) *missing = name;
      return false;
    }
  }
  return true;
}

// Model used for a session. A calibrated AD8232 gain allows the models that use ECG amplitudes
// (primary first, then ECG-only); without it only the gain-invariant fallback is safe.
inline ModelRole chooseModel(bool gain_calibrated, const NonEcgInputs& p, const char** reason = nullptr) {
  const ModelRole order_cal[] = {ModelRole::kPrimary, ModelRole::kEcgOnly};
  const ModelRole order_uncal[] = {ModelRole::kFallback};
  const ModelRole* order = gain_calibrated ? order_cal : order_uncal;
  const int n = gain_calibrated ? 2 : 1;
  for (int i = 0; i < n; ++i)
    if (nonEcgInputsAvailable(modelSpec(order[i]), p)) return order[i];
  if (reason) {
    *reason = gain_calibrated ? "Enter your profile (age, sex, height, weight) to get a result"
                              : "Enter your profile (age, sex, height, weight), or calibrate the ECG gain to use "
                                "the ECG-only model";
  }
  return ModelRole::kNone;
}

// Fills x (m.n_inputs values) for one ECG window; false if an input name is unknown.
inline bool fillInputs(const ModelSpec& m, const EcgFeatures& f, const NonEcgInputs& p, float* x) {
  for (int i = 0; i < m.n_inputs; ++i)
    if (!inputValue(m.input_names[i], f, p, &x[i])) return false;
  return true;
}

}  // namespace dgx
